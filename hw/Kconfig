## hw/Kconfig
```kconfig
# devices Kconfig
source 9pfs/Kconfig
source acpi/Kconfig
source adc/Kconfig
source audio/Kconfig
source block/Kconfig
source char/Kconfig
source core/Kconfig
source cxl/Kconfig
source display/Kconfig
source dma/Kconfig
source fsi/Kconfig
source gpio/Kconfig
source hyperv/Kconfig
source i2c/Kconfig
source ide/Kconfig
source input/Kconfig
source intc/Kconfig
source ipack/Kconfig
source ipmi/Kconfig
source isa/Kconfig
source mem/Kconfig
source misc/Kconfig
source net/Kconfig
source nubus/Kconfig
source nvme/Kconfig
source nvram/Kconfig
source pci-bridge/Kconfig
source pci-host/Kconfig
source pci/Kconfig
source remote/Kconfig
source rtc/Kconfig
source scsi/Kconfig
source sd/Kconfig
source sensor/Kconfig
source smbios/Kconfig
source ssi/Kconfig
source timer/Kconfig
source tpm/Kconfig
source uefi/Kconfig
source ufs/Kconfig
source usb/Kconfig
source virtio/Kconfig
source vfio/Kconfig
source vfio-user/Kconfig
source vmapple/Kconfig
source xen/Kconfig
source watchdog/Kconfig

# arch Kconfig
source arm/Kconfig
source cpu/Kconfig
source alpha/Kconfig
source avr/Kconfig
source hppa/Kconfig
source i386/Kconfig
source loongarch/Kconfig
source m68k/Kconfig
source microblaze/Kconfig
source mips/Kconfig
source openrisc/Kconfig
source ppc/Kconfig
source riscv/Kconfig
source rx/Kconfig
source s390x/Kconfig
source sh4/Kconfig
source sparc/Kconfig
source sparc64/Kconfig
source tricore/Kconfig
source xtensa/Kconfig

# for study ref. https://mp.weixin.qq.com/s?__biz=MzkzMTk4OTIwNg==&mid=2247485019&idx=1&sn=b70b64648b7a867dfa5304a6654b9c42&chksm=c263d5e2f5145cf4ed22f04d13020e96dc4b7000d9f5ad47fd8147cb7f8ca29395a901973260&cur_album_id=4004436609855717378&scene=190#rd
source pci-test-dev/Kconfig

# Symbols used by multiple targets
config TEST_DEVICES
    bool

config XILINX
    bool
    select PTIMER # for hw/timer/xilinx_timer.c

config XILINX_AXI
    bool
    select PTIMER # for hw/dma/xilinx_axidma.c

config XLNX_ZYNQMP
    bool
    select REGISTER
    select CAN_BUS
    select PTIMER
    select XLNX_BBRAM
    select XLNX_EFUSE_ZYNQMP
```
